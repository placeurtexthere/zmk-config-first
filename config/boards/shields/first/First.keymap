#include <behaviors.dtsi>
#include <dt-bindings/zmk/keys.h>
#include <dt-bindings/zmk/bt.h>

/ {
    keymap {
        compatible = "zmk, keymap";
        default_layer {
            bindings = <
                &kp 0   &kp 1   &kp 2   &kp 3   &kp 4   &kp 5   &kp 6   &kp 7   &kp 8   &kp 9   &kp Ö   &kp Ü   &kp Ó   &kp BSPC   &kp ESC
                &kp TAB    &kp Q   &kp W   &kp E   &kp R   &kp T   &kp Z   &kp U   &kp I   &kp O   &kp P   &kp Ő   &kp Ú   &mo 1
                &kpCAPS    &kp A    &kp S    &kp D    &kp F    &kp G    &kp H    &kp J    &kp K    &kp L    &kp É    &kp Á    &kp Ű    &kp ENTER     &MO 2
                &kp LSHIFT    &kp Í    &kp Y    &kp X    &kp C    &kp V    &kp B    &kp N    &kp M    &kp ,    &kp .    &kp -    &kp RSHIFT    &kp UP    &mo 4
                &mo 3    &kp LCTRL    &kp LALT    &kp LGUI    &kp SPACE    &kp RGUI    &kp RALT    &kp LEFT    &kp DOWN    &kp RIGHT
            >;
        };

        bt_layer {
            bindings = <
                &bt BT_SEL 0   &bt BT_SEL 1   &bt BT_SEL 2   &none   &none   &none   &none   &none   &none   &none   &none   &none   &none   &bt BT_CLR   &none
                &none     &none   &none   &none   &none   &none   &none   &none   &none   &none   &none   &none                     &none
                &none      &none   &none   &none   &none   &none   &none   &none   &none   &none   &none   &none   &none   &bootloader    &none
                &none   &none   &none   &none   &none   &none   &none   &none   &none   &none   &none   &none   &none       &none   &none
                &none   &none   &none   &none                       &none                           &none   &none   &none   &none   &none
            >;
        };
    }
}
